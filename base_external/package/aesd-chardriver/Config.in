## base_external/package/aesd-chardriver/Config.in
```kconfig
config BR2_PACKAGE_AESD_CHARDRIVER
	bool "aesd-chardriver"
	depends on BR2_LINUX_KERNEL
	help
	  Aesd Character Driver
```

## base_external/package/aesd-chardriver/config.in
```kconfig
config BR2_PACKAGE_AESD_CHARDRIVER
	bool "aesd-chardriver"
	help
	  Aesd Character Driver
	  Used to understand buildroot external trees and package builds.
na
```

## base_external/package/ldd/Config.in
```kconfig
config BR2_PACKAGE_LDD
    bool "LDD kernel module"
    depends on BR2_LINUX_KERNEL
    help 
        Example for Assignment 7
```
